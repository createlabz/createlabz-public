#include <U8glib.h>

U8GLIB_ST7920_128X64_4X u8g(10);

const uint8_t rook_bitmap[] U8G_PROGMEM = {
0x00, 0x00, 0x00, 0x00, 0x00, 0x00, 0x00, 0x00, 0x00, 0x00, 0x00, 0x00,
   0x00, 0x00, 0x00, 0x00, 0x00, 0x00, 0x00, 0x00, 0x00, 0x00, 0x00, 0x00,
   0x00, 0x00, 0x00, 0x00, 0x00, 0x00, 0x00, 0x00, 0x00, 0x00, 0x00, 0x00,
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   0x00, 0x00, 0x00, 0x00 



    };       

void draw() {

  //u8g.setFont(u8g_font_unifont);
  u8g.setFont(u8g_font_osb18);
   u8g.drawStr( 03, 27, "Createlabz");
   u8g.drawStr( 36, 52, "Store");

}

void picture() {
  u8g.drawXBMP( 0, 0, 128, 64, rook_bitmap);
}

void next() {

  u8g.setFont(u8g_font_unifont);
  //u8g.setFont(u8g_font_osb18);
  u8g.drawStr( 07, 18, "Interfacing");
  u8g.drawStr( 07, 38, "128 X 64 LCD");
  u8g.drawStr( 07, 58, "with Arduino");
  
}

void clearLCD(){
    u8g.firstPage();  
    do {
    } while( u8g.nextPage() );
}

void setup() {

  // assign default color value
  if ( u8g.getMode() == U8G_MODE_R3G3B2 ) {
    u8g.setColorIndex(255);     // white
  }
  else if ( u8g.getMode() == U8G_MODE_GRAY2BIT ) {
    u8g.setColorIndex(3);         // max intensity
  }
  else if ( u8g.getMode() == U8G_MODE_BW ) {
    u8g.setColorIndex(1);         // pixel on
  }
  else if ( u8g.getMode() == U8G_MODE_HICOLOR ) {
    u8g.setHiColorByRGB(255,255,255);
  }
}

void loop() {
  // picture loop
  u8g.firstPage();  
  do {
    u8g.drawFrame(1,2,126,62);
    draw();
    
  } while( u8g.nextPage() );
  delay(2000);
  clearLCD();
  u8g.firstPage();  

  
  do {
    u8g.drawFrame(1,2,126,62);
    next();
  } while( u8g.nextPage() );
    delay(2000);
  clearLCD();
  u8g.firstPage();  

  
  do {
     picture();
  } while( u8g.nextPage() );
  delay(2000);
 clearLCD();
  // rebuild the picture after some delay
  delay(50);
}
